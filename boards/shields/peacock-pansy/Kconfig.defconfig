## boards/shields/peacock-pansy/Kconfig.defconfig
```kconfig
# Copyright (c) 2025 Alyx
# SPDX-License-Identifier: MIT

if SHIELD_PEACOCKPANSY

config ZMK_KEYBOARD_NAME
    default "Peacock Pansy"

config ZMK_POINTING
    default y

config SPI
    default y

endif
```

## boards/shields/peacock-pansy/Kconfig.shield
```kconfig
# Copyright (c) 2025 Alyx
# SPDX-License-Identifier: MIT

config SHIELD_PEACOCKPANSY
    def_bool $(shields_list_contains,peacock-pansy)
```

## config/west.yml
```yaml
manifest:
  remotes:
    - name: petejohanson
      url-base: https://github.com/petejohanson
    - name: zmkfirmware
      url-base: https://github.com/zmkfirmware
  projects:
    - name: zmk
      remote: zmkfirmware
      revision: main
      import: app/west.yml
    - name: cirque-input-module
      remote: petejohanson
      revision: main
  self:
    path: config
```
